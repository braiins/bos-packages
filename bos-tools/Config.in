## bos-tools/Config.in
```kconfig
config EXTERNAL_BOS_TOOLS_BIN_PATH
    string "Set path to BOS tools binary" if DEVEL
    default ""
```

## boser/Config.in
```kconfig
config EXTERNAL_BOSER_BIN_PATH
    string "Set path to BOSer binary" if DEVEL
    default ""

config EXTERNAL_BOSER_WWW_PATH
    string "Set www source for BOSer" if DEVEL
    default ""

config EXTERNAL_BOSER_WWW_VAR_PATH
    string "Set var path for BOSer" if DEVEL
    default ""
```

## bosminer/Config.in
```kconfig
config EXTERNAL_BOSMINER_BIN_PATH
    string "Set path to BOSminer binary" if DEVEL
    default ""
```

## braa/Config.in
```kconfig
config EXTERNAL_BRAA_TREE
    string "Set path to braa tree" if DEVEL
    default ""
```

## espflash/Config.in
```kconfig
config EXTERNAL_ESPFLASH_TREE
    string "Set path to espflash tree" if DEVEL
    default ""
```

## firmware/Config.in
```kconfig
config FIRMWARE_MAJOR
    string "Firmware major version"
    default ""

config FIRMWARE_VERSION
    string "Firmware version"
    default ""

config FIRMWARE_REQUIRE
    string "Previous firmware version required by this firmware"
    default ""

config VERSION_PATH
    string "Path to version.json file that holds SW version"
    default ""
```
